## firmware/class_c6/main/Kconfig.projbuild
```kconfig
menu "imPress C6 Gateway Configuration"

    menu "WiFi"
        config WIFI_SSID
            string "WiFi SSID"
            default "impress-hotspot"
            help
                SSID of the WiFi network the C6 connects to (backend LAN).

        config WIFI_PASSWORD
            string "WiFi Password"
            default "impress123"
            help
                Password for the WiFi network.

        config WIFI_MAX_RETRY
            int "Max WiFi connect retries"
            range 3 30
            default 10
            help
                Maximum WiFi connection attempts before entering backoff.

    endmenu

    menu "Backend Server"
        config BACKEND_HOST
            string "Backend IP or hostname"
            default "192.168.137.1"
            help
                IP or hostname of the FastAPI backend.

        config BACKEND_PORT
            int "Backend HTTP port"
            default 8000
            help
                HTTP port of the FastAPI backend.

        config DEVICE_API_KEY
            string "Device API key"
            default "impress-device-key-2024"
            help
                Shared secret sent in X-API-Key header and WS ?api_key= param.
                Must match IMPRESS_DEVICE_API_KEY on the backend.

        config CLASS_SESSION_ID
            int "Class session ID (0 = auto-assign on first WS)"
            default 0
            help
                Set to 0 to have the backend assign the class on first connect.
                Set a positive integer to pin this gateway to a specific class.

    endmenu

    menu "Timing"
        config HEARTBEAT_INTERVAL_S
            int "Heartbeat interval (seconds)"
            range 5 300
            default 15
            help
                How often the C6 sends a heartbeat to the backend.

        config WS_PING_INTERVAL_S
            int "WebSocket ping interval (seconds)"
            range 10 120
            default 30

        config STATUS_PING_INTERVAL_S
            int "Classroom status ping interval (seconds)"
            range 60 600
            default 120
            help
                How often the C6 sends a classroom status update (student count,
                uptime, class_id) to the backend. This is the "give updates
                every 2 minutes" ping — separate from the fast liveness heartbeat.

        config SPI_BATCH_MAX_WAIT_MS
            int "Max time to wait before flushing SPI batch (ms)"
            range 100 5000
            default 500
            help
                The SPI→HTTP task accumulates student messages for up to this
                many milliseconds before flushing them as a single /api/device/batch POST.

        config BATCH_MAX_SIZE
            int "Max messages per batch"
            range 5 50
            default 20
            help
                Maximum number of student messages per HTTP batch POST.

    endmenu

    menu "Battery ADC (optional)"
        config BATTERY_ADC_EN
            bool "Enable battery voltage ADC reading"
            default n
            help
                Enable if a voltage divider on ADC GPIO is used to monitor
                the gateway power supply.

        config BATTERY_ADC_GPIO
            int "Battery ADC GPIO number"
            default 4
            depends on BATTERY_ADC_EN

    endmenu

endmenu
```

## firmware/class_s3/main/Kconfig.projbuild
```kconfig
menu "imPress S3 Class Module Configuration"

    menu "WiFi (OTA only)"
        config WIFI_SSID
            string "WiFi SSID"
            default "impress-hotspot"
            help
                SSID of the WiFi network the S3 attaches to ONLY during
                OTA updates. Normally the S3 uses ESP-NOW and is off-WiFi.

        config WIFI_PASSWORD
            string "WiFi Password"
            default "impress123"
            help
                Password for the WiFi network (used for OTA only).

        config WIFI_MAX_RETRY
            int "Max WiFi connect retries (OTA)"
            range 3 15
            default 5
            help
                Maximum WiFi connection attempts during OTA. If this many
                fail, the S3 abandons OTA and returns to mesh duty.

    endmenu

    menu "Backend Server (OTA)"
        config BACKEND_HOST
            string "Backend IP or hostname"
            default "192.168.1.100"
            help
                IP or hostname of the FastAPI backend (for OTA downloads).

        config BACKEND_PORT
            int "Backend port (HTTP, or HTTPS with BACKEND_TLS)"
            default 8000
            help
                HTTP port of the FastAPI backend.

        config DEVICE_API_KEY
            string "Device API key"
            default "impress-device-key-2024"
            help
                The site's shared provisioning key, sent as X-API-Key during
                the OTA hop until the hub is issued its own key (#66).
                Must match IMPRESS_DEVICE_API_KEY on the backend.

        config BACKEND_TLS
            bool "Use HTTPS / WSS to reach the backend"
            default n
            help
                Encrypt device traffic and authenticate the server (#66).
                Point BACKEND_HOST at the name in the server's certificate
                and BACKEND_PORT at its TLS port (usually 443).

        choice BACKEND_TLS_TRUST
            prompt "Trust the server's certificate through"
            depends on BACKEND_TLS
            default BACKEND_TLS_CRT_BUNDLE

            config BACKEND_TLS_CRT_BUNDLE
                bool "Public certificate authorities (ESP-IDF bundle)"
                select MBEDTLS_CERTIFICATE_BUNDLE
                help
                    For a server certificate from a public CA such as Let's Encrypt.

            config BACKEND_TLS_CA_FILE
                bool "certs/backend_ca.pem in this project"
                help
                    Trust only this CA: a private CA, or the server's own
                    self-signed certificate. Put the PEM at
                    firmware/<project>/certs/backend_ca.pem before building;
                    it is embedded in the image.
        endchoice
    endmenu

    menu "Mesh Timing"
        config HEARTBEAT_INTERVAL_MS
            int "Heartbeat interval (ms)"
            range 2000 60000
            default 5000
            help
                How often the S3 sends status to the C6 via SPI.

        config STUDENT_TIMEOUT_MS
            int "Student timeout (ms)"
            range 10000 300000
            default 60000
            help
                If no message is received from a student node for this long,
                mark it inactive in the routing table.

        config SPI_POLL_INTERVAL_MS
            int "SPI poll interval (ms)"
            range 20 500
            default 50
            help
                How often the S3 polls the C6 for commands via SPI.

        config SPI_CLOCK_MHZ
            int "S3 <-> C6 SPI clock (MHz)"
            range 1 40
            default 10
            help
                Standard full-duplex SPI clock. 10 MHz is reliable on hand-wired
                boards (validated in the v3 demo); a PCB with short traces can go
                higher. One 4096-byte slot takes ~3.3 ms at 10 MHz.

        config MESH_WIFI_CHANNEL
            int "Mesh WiFi channel (1-13)"
            range 1 13
            default 1
            help
                WiFi channel used for ESP-NOW mesh between S3 and students.
                Must match student module channel.

    endmenu

endmenu
```

## firmware/student/main/Kconfig.projbuild
```kconfig
menu "imPress Student Module Configuration"

    config IMPRESS_EMULATOR
        bool "Emulator build (QEMU boot test only; never flash to a board)"
        default n
        help
            Builds the firmware for the TrustedInstaller boot test in Espressif's
            QEMU (#154). QEMU emulates the chip, flash and timers but not the
            radio, so this build skips the ESP-NOW mesh and logs
            "EMULATOR: ... skipped", then runs everything else. A board running
            this build cannot reach any student or gateway.
endmenu
```

## firmware/student/sdkconfig.defaults
```kconfig
# Student module config
CONFIG_ESP_WIFI_CHANNEL=1
CONFIG_ESP_NOW_MAX_DATA_LEN=250
CONFIG_FREERTOS_HZ=1000

# Low power for battery operation
CONFIG_PM_ENABLE=y
CONFIG_PM_DFS_INIT_AUTO=y

# Logging
CONFIG_LOG_DEFAULT_LEVEL_INFO=y

# Flash + OTA partitions (4MB flash, dual OTA slots for mesh OTA)
CONFIG_ESPTOOLPY_FLASHSIZE_4MB=y
CONFIG_ESPTOOLPY_FLASHSIZE="4MB"
CONFIG_PARTITION_TABLE_CUSTOM=y
CONFIG_PARTITION_TABLE_CUSTOM_FILENAME="partitions.csv"
CONFIG_PARTITION_TABLE_FILENAME="partitions.csv"
```
